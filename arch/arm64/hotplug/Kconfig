## arch/arm64/hotplug/Kconfig
```kconfig
config BRICKED_HOTPLUG
	   bool "Enable kernel based mpdecision"
	   depends on MSM_RUN_QUEUE_STATS
	   default n
	   help
		 This enables kernel based multi core control.

config ALUCARD_HOTPLUG
	bool "Enable alucard-hotplug cpu hotplug driver"
	default n
	help
	Generic Alucard-hotplug cpu hotplug driver for ARM SOCs

config INTELLI_HOTPLUG
        bool "Enable intelli-hotplug cpu hotplug driver"
        default n
        help
          Generic Intelli-plug cpu hotplug driver for ARM SOCs

config HIMA_HOTPLUG
        bool "Enable hima-hotplug cpu hotplug driver"
	depends on STATE_NOTIFIER
        default n
        help
          Generic cpu hotplugging driver for ARM SOCs
		  
config MSM_HOTPLUG
	bool "Enable msm-hotplug cpu hotplug driver"
	default n
	help
	Generic msm-hotplug cpu hotplug driver for ARM SOCs
	
config BLU_PLUG
	bool "Dynamic hotplug driver"
	depends on HOTPLUG_CPU
	default n
	help
          The Dynamic hotplug driver automatically online/offline CPUs proportional to system load.
```
